## Kconfig.projbuild
```kconfig
menu "Firebase CRUD Example Configuration"

    config EXAMPLE_WIFI_SSID
        string "WiFi SSID"
        default "for ras-pi"
        help
            SSID (network name) for the example to connect to.

    config EXAMPLE_WIFI_PASSWORD
        string "WiFi Password"
        default "myhome7808"
        help
            WiFi password (WPA or WPA2) for the example to use.

    config EXAMPLE_FIREBASE_HOST
        string "Firebase Database Host"
        default "aquasense-beostar-default-rtdb.asia-southeast1.firebasedatabase.app"
        help
            Firebase Realtime Database host URL.

    config EXAMPLE_FIREBASE_API_KEY
        string "Firebase API Key"
        default "AIzaSyCaQTwrlJFB21eIBp4jXhd5mw9skLegdcM"
        help
            Firebase API key for authentication.

endmenu 
```

## sdkconfig.defaults
```kconfig
# Enable LWIP and HTTP client
CONFIG_LWIP_IPV6=y
CONFIG_LWIP_IPV4=y

# Main task stack size
CONFIG_ESP_MAIN_TASK_STACK_SIZE=8192

# Enable TLS certificates
CONFIG_MBEDTLS_CERTIFICATE_BUNDLE=y 
```
